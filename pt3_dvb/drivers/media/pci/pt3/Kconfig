## pt3_dvb/drivers/media/pci/pt3/Kconfig
```kconfig
config DVB_PT3
	tristate "Earthsoft PT3 cards"
	depends on DVB_CORE && PCI && I2C
	select DVB_TC90522 if MEDIA_SUBDRV_AUTOSELECT
	select MEDIA_TUNER_QM1D1C0042 if MEDIA_SUBDRV_AUTOSELECT
	select MEDIA_TUNER_MXL301RF if MEDIA_SUBDRV_AUTOSELECT
	help
	  Support for Earthsoft PT3 PCIe cards.
	  You need to enable frontend (TC90522) & tuners (QM1D1C0042, MXL301RF)
	  Say Y or M if you own such a device and want to use it.
```

## pt3_dvb/drivers/media/pci/pt3_dvb/Kconfig
```kconfig
config PT3_DVB
	tristate "Earthsoft PT3 cards"
	depends on DVB_CORE && PCI
	help
	  Support for Earthsoft PT3 PCI-Express cards.

	  Since these cards have no MPEG decoder onboard, they transmit
	  only compressed MPEG data over the PCI bus, so you need
	  an external software decoder to watch TV on your computer.

	  Say Y or M if you own such a device and want to use it.
```

## pt3_dvb2/drivers/media/pci/pt3/Kconfig
```kconfig
config PT3_DVB
	tristate "Earthsoft PT3 ISDB-S/T cards"
	depends on DVB_CORE && PCI
	select DVB_TC90522 if MEDIA_SUBDRV_AUTOSELECT
	select MEDIA_TUNER_QM1D1C0042 if MEDIA_SUBDRV_AUTOSELECT
	select MEDIA_TUNER_MXL301RF if MEDIA_SUBDRV_AUTOSELECT
	help
	  Support for Earthsoft PT3 PCI-Express cards.
	  You need to enable frontend (TC90522) & tuners (QM1D1C0042, MXL301RF)
	  Say Y or M if you own such a device and want to use it.
```

## ptx_dvb/drivers/media/pci/ptx/Kconfig
```kconfig
config DVB_PT3
	tristate "Earthsoft PT3 cards"
	depends on DVB_CORE && PCI && I2C
	select DVB_PTX_COMMON
	select DVB_TC90522 if MEDIA_SUBDRV_AUTOSELECT
	select MEDIA_TUNER_QM1D1C004X if MEDIA_SUBDRV_AUTOSELECT
	select MEDIA_TUNER_MXL301RF if MEDIA_SUBDRV_AUTOSELECT
	help
	  Support for Earthsoft PT3 ISDB-S/T PCIe cards.

	  Say Y or M if you own such a device and want to use it.

config DVB_PXQ3PE
	tristate "PLEX PX-Q3PE cards"
	depends on DVB_CORE && PCI && I2C
	select DVB_PTX_COMMON
	select DVB_TC90522 if MEDIA_SUBDRV_AUTOSELECT
	select MEDIA_TUNER_QM1D1C004X if MEDIA_SUBDRV_AUTOSELECT
	select MEDIA_TUNER_MXL301RF if MEDIA_SUBDRV_AUTOSELECT
	help
	  Support for PLEX PX-Q3PE ISDB-S/T PCIe cards.

	  Say Y or M if you own such a device and want to use it.
```
